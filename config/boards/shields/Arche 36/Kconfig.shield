## config/boards/shields/Arche 36/Kconfig.shield
```kconfig
config SHIELD_ARCHE_LEFT
	def_bool $(shields_list_contains,arche_left)

config SHIELD_ARCHE_RIGHT
	def_bool $(shields_list_contains,arche_right)
```

## config/boards/shields/arche/Kconfig.defconfig
```kconfig
if SHIELD_ARCHE_LEFT

config ZMK_KEYBOARD_NAME
    default "Arche36"

config ZMK_SPLIT_BLE_ROLE_CENTRAL
    default y

endif

if SHIELD_ARCHE_LEFT || SHIELD_ARCHE_RIGHT

config ZMK_SPLIT
    default y

endif
```
